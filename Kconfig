## Kconfig
```kconfig
menu "GNSS-Parser"
    menu "Formats"
        config GNSS_PARSER_FORMAT_GSA
            bool "Include the GSA format"
            default n
            help
                Enable this option if you want to use the the GSA parsing option.

        config GNSS_PARSER_FORMAT_GSV
            bool "Include the GSV format"
            default n
            help
                Enable this option if you want to use the the GSV parsing option.

        config GNSS_PARSER_FORMAT_GGA
            bool "Include the GGA format"
            default n
            help
                Enable this option if you want to use the the GGA parsing option.

        config GNSS_PARSER_FORMAT_RMC
            bool "Include the RMC format"
            default n
            help
                Enable this option if you want to use the the RMC parsing option.

        config GNSS_PARSER_FORMAT_GLL
            bool "Include the GLL format"
            default n
            help
                Enable this option if you want to use the the GLL parsing option.

        config GNSS_PARSER_FORMAT_VTG
            bool "Include the VTG format"
            default n
            help
                Enable this option if you want to use the the VTG parsing option.
    endmenu

    menu "Event loop"
        config GNSS_PARSER_EVENT_LOOP_QUEUE_SIZE
            int "Queue size for the event loop"
            range 8 32
            default 16
            help
                Number of maximum items in the event loop.
    endmenu

    menu "UART"
		config GNSS_PARSER_UART_IRAM
			bool "Place ISR in IRAM"
			default n

        config GNSS_PARSER_UART_BUFFER_SIZE
            int "Buffer size"
            range 256 1024
            default 512
            help
                Buffer size for the UART.

        config GNSS_PARSER_UART_QUEUE_LENGTH
            int "Queue length"
            range 4 32
            default 16
            help
                Queue length for the UART receive buffer.
    endmenu

    menu "FreeRTOS"
        config GNSS_PARSER_TASK_PRIO
            int "Receive task priority"
            range 12 25
            default 12
            help
                Task priority for the UART receive task.

        config GNSS_PARSER_TASK_BUFFER_SIZE
            int "Buffer size"
            range 2048 8192
            default 2048
            help
                Buffer size for the UART receive buffer.

        config GNSS_PARSER_TASK_QUEUE_LENGTH
            int "Queue length"
            range 4 16
            default 8
            help
                Queue length for the UART receive buffer.

        config GNSS_PARSER_TASK_CORE_USE_AFFINITY
            bool "Use core affinity"
            default n
            help
                Enable this option if you want to use a specific core for the UART receive task.

        config GNSS_PARSER_TASK_CORE
            int "Receive task core"
            depends on GNSS_PARSER_TASK_CORE_USE_AFFINITY
            range 0 1
            default 1
            help
                Core used by the UART receive task.
    endmenu

    menu "Misc"
        config GNSS_PARSER_MISC_ERROR_BASE
            hex "GNSS-Parser error base definition"
            range 0 FFFF
            default 0x8000
            help
                Set the error base for the driver.
    endmenu
endmenu
```

## example/Kconfig.projbuild
```kconfig
menu "GNSS-Parser"
	config GNSS_PARSER_UART_INTERFACE
		int "UART port number"
		range 0 2
		default 1
		help
			UART communication port number for the driver.
			See UART documentation for available port numbers.

	config GNSS_PARSER_UART_RX
		int "UART RXD pin number"
		default 5
		help
			GPIO number for UART RX pin. See UART documentation for more information
			about available pin numbers for UART.

	choice
		prompt "Baud rate"

		config GNSS_PARSER_BAUD_9600
			bool "9600"

		config GNSS_PARSER_BAUD_19200
			bool "19200"

		config GNSS_PARSER_BAUD_38400
			bool "38400"

		config GNSS_PARSER_BAUD_57600
			bool "57600"

		config GNSS_PARSER_BAUD_115200
			bool "115200"
	endchoice

	config GNSS_PARSER_UART_BAUD
		int
		default 9600 if GNSS_PARSER_BAUD_9600
		default 19200 if GNSS_PARSER_BAUD_19200
		default 38400 if GNSS_PARSER_BAUD_38400
		default 57600 if GNSS_PARSER_BAUD_57600
		default 115200 if GNSS_PARSER_BAUD_115200
endmenu
```
